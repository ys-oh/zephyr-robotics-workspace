## west.yml
```yaml
manifest:
  self:
    path: zephyr-robotics-workspace

  remotes:
    - name: zephyrproject-rtos
      url-base: https://github.com/zephyrproject-rtos

    - name: ysoh
      url-base: https://github.com/ys-oh

  projects:
    - name: zephyr
      remote: zephyrproject-rtos
      revision: main
      import: true

    - name: jsmn-helper
      remote: ysoh
      revision: c624c43f30b18be2fdcc60d201b3c16d1b02b3e5 
      path: modules/data/jsmn-helper
      groups:
        - data

    - name: libev
      remote: ysoh
      revision: 02b955d98bf686c08baf7623edeac79333c1d188
      path: modules/libev
```
